## sdkconfig.defaults
```kconfig
CONFIG_IDF_TARGET="esp32c2"

CONFIG_FREERTOS_HZ=1000

CONFIG_ESP_CONSOLE_UART_DEFAULT=y
CONFIG_ESP_CONSOLE_UART_BAUDRATE=115200

CONFIG_PARTITION_TABLE_SINGLE_APP=y

CONFIG_COMPILER_OPTIMIZATION_SIZE=y

CONFIG_ESPTOOLPY_FLASHMODE_DIO=y
CONFIG_ESPTOOLPY_FLASHSIZE_2MB=y
CONFIG_ESPTOOLPY_FLASHFREQ_40M=y
```
